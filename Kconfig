## Kconfig
```kconfig
menu "Status LED"
    config STATUS_LED_DEFAULT_ENABLE
        bool "Enable default status LED object"
        help
            Makes STATUS_LED_DEFAULT object available, but it still needs to be created via status_led_create_default().

    config STATUS_LED_DEFAULT_GPIO
        int "Status LED GPIO"
        default 0
        depends on STATUS_LED_DEFAULT_ENABLE
        help
            GPIO PIN status LED is connected to.

    config STATUS_LED_DEFAULT_ON
        int "Status LED ON logic level"
        default 1
        depends on STATUS_LED_DEFAULT_ENABLE
        help
            GPIO logic leven, when status LED is powerd on - 1 when HIGH corresponds to an ON state, 0 when LOW corresponds to an ON state.
endmenu
```

## example/sdkconfig.defaults
```kconfig
# Debug in sample
CONFIG_LOG_DEFAULT_LEVEL_DEBUG=y

# Default status LED
CONFIG_STATUS_LED_DEFAULT_ENABLE=y
CONFIG_STATUS_LED_DEFAULT_GPIO=22
CONFIG_STATUS_LED_DEFAULT_ON=0
```
